## config/boards/shields/libre/Kconfig.defconfig
```kconfig
if SHIELD_LIBRE_LEFT

# Name must be less than 16 characters long!
config ZMK_KEYBOARD_NAME
    default "libre"

config ZMK_SPLIT_ROLE_CENTRAL
    default y

endif

if SHIELD_LIBRE_LEFT || SHIELD_LIBRE_RIGHT

config ZMK_SPLIT
    default y

endif
```

## config/boards/shields/libre/Kconfig.shield
```kconfig
config SHIELD_LIBRE_LEFT
    def_bool $(shields_list_contains,libre_left)

config SHIELD_LIBRE_RIGHT
    def_bool $(shields_list_contains,libre_right)
```
